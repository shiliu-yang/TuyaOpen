## apps/tuya.ai/your_chat_bot/src/display/Kconfig
```kconfig
if(ENABLE_CHAT_DISPLAY)
config ENABLE_GUI_STREAM_AI_TEXT
    depends on ENABLE_GUI_WECHAT
    bool "support streaming display of ai text"
    default n

# UI choice
choice
    prompt "choose display gui"
    default ENABLE_GUI_WECHAT

    config ENABLE_GUI_WECHAT
        bool "WeChat-like"

    config ENABLE_GUI_CHATBOT
        bool "Chatbot"

    config ENABLE_GUI_OLED
        bool "OLED"
endchoice

# text choice
choice
    prompt "choose text font"
    default FONT_TEXT_PUHUI_14_1

    config FONT_TEXT_PUHUI_14_1
        bool "Puhui 14 1"

    config FONT_TEXT_PUHUI_16_2
        bool "Puhui 16 2"

    config FONT_TEXT_PUHUI_16_4
        bool "Puhui 16 4"

    config FONT_TEXT_PUHUI_18_2
        bool "Puhui 18 2"

    config FONT_TEXT_PUHUI_20_2
        bool "Puhui 20 2"

    config FONT_TEXT_PUHUI_20_4
        bool "Puhui 20 4"

    config FONT_TEXT_PUHUI_30_4
        bool "Puhui 30 4"
endchoice

# icon choice
choice
    prompt "choose icon font"
    default FONT_ICON_AWESOME_14_1

    config FONT_ICON_AWESOME_14_1
        bool "awesome 14 1"

    config FONT_ICON_AWESOME_16_4
        bool "awesome 16 4"

    config FONT_ICON_AWESOME_20_4
        bool "awesome 20 4"

    config FONT_ICON_AWESOME_30_1
        bool "awesome 30 1"

    config FONT_ICON_AWESOME_30_4
        bool "awesome 30 4"
endchoice

# emoji choice
choice
    prompt "choose emoji font"
    default FONT_EMOJI_AWESOME_14_1

    config FONT_EMOJI_AWESOME_14_1
        bool "awesome 14 1"

    config FONT_EMOJI_AWESOME_16_4
        bool "awesome 16 4"

    config FONT_EMOJI_AWESOME_20_4
        bool "awesome 20 4"

    config FONT_EMOJI_AWESOME_30_1
        bool "awesome 30 1"

    config FONT_EMOJI_AWESOME_30_4
        bool "awesome 30 4"

    config FONT_EMOJI_IMAGE_32
        bool "image 32"

    config FONT_EMOJI_IMAGE_64
        bool "image 64"
endchoice

endif
```

## apps/waveshare_t5ai_touch_amoled_1_75/BMM150/Kconfig
```kconfig
menu "BMM150 Magnetometer Demo"

config BMM150_DEMO_ENABLE
    bool "Enable BMM150 Magnetometer Demo"
    default y
    help
        Enable the BMM150 magnetometer demo application.
        This demo uses software I2C on pins P20 (SCL) and P21 (SDA).

config BMM150_DATA_RATE
    int "BMM150 Data Rate (Hz)"
    default 10
    depends on BMM150_DEMO_ENABLE
    help
        Data rate for BMM150 magnetometer readings in Hz.
        Valid values: 2, 6, 8, 10, 15, 20, 25, 30

config BMM150_REPETITION_XY
    int "BMM150 XY Repetition"
    default 4
    depends on BMM150_DEMO_ENABLE
    help
        XY axis repetition setting for BMM150.
        Higher values provide better accuracy but slower response.

config BMM150_REPETITION_Z
    int "BMM150 Z Repetition"
    default 4
    depends on BMM150_DEMO_ENABLE
    help
        Z axis repetition setting for BMM150.
        Higher values provide better accuracy but slower response.

endmenu
```

## apps/waveshare_t5ai_touch_amoled_1_75/GPS/Kconfig
```kconfig
menu "Application config"

    choice GPS_INTERFACE
        prompt "GPS Interface Type"
        default USE_GPS_I2C
        help
            Select the communication interface for GPS module

        config USE_GPS_I2C
            bool "I2C Interface"
            help
                Use I2C interface for GPS communication

        config USE_GPS_UART
            bool "UART Interface"
            help
                Use UART interface for GPS communication
    endchoice

    config EXAMPLE_I2C_SCL_PIN
        int "scl pin"
        default 20
        range 0 63
        depends on USE_GPS_I2C

    config EXAMPLE_I2C_SDA_PIN
        int "sda pin"
        default 21
        range 0 63
        depends on USE_GPS_I2C

    config EXAMPLE_UART_PORT
        int "UART Port Number (0-5)"
        default 2
        range 0 5
        depends on USE_GPS_UART
        help
            Select UART port number for GPS module

    config EXAMPLE_UART_TX_PIN
        int "UART TX pin"
        default 41
        range 0 63
        depends on USE_GPS_UART
        help
            GPIO pin for UART TX (P41 for UART2_TX)

    config EXAMPLE_UART_RX_PIN
        int "UART RX pin"
        default 40
        range 0 63
        depends on USE_GPS_UART
        help
            GPIO pin for UART RX (P40 for UART2_RX)

    config EXAMPLE_UART_BAUDRATE
        int "UART Baudrate"
        default 9600
        depends on USE_GPS_UART
        help
            Baudrate for UART communication with GPS module

    config GPS_ENABLE_NMEA_DEBUG
        bool "Enable NMEA sentence debug output"
        default n
        help
            Enable detailed NMEA sentence parsing logs for debugging

endmenu
```

## apps/waveshare_t5ai_touch_amoled_1_75/QMI8658/Kconfig
```kconfig
menu "Application config"

    config EXAMPLE_I2C_SCL_PIN
        int "scl pin"
        default 20
        range 0 63

    config EXAMPLE_I2C_SDA_PIN
        int "sda pin"
        default 21
        range 0 63

endmenu
```

## apps/waveshare_t5ai_touch_amoled_1_75/htx-ai-cattle-tracker/Kconfig
```kconfig
menu "configure app (htx-ai-cattle-tracker) "

config TUYA_PRODUCT_ID
    string "product ID of project"
    default "awtowrksuozwqqmx"

choice 
    prompt "choose chat mode"
    default ENABLE_CHAT_MODE_ASR_WAKEUP_FREE

    config ENABLE_CHAT_MODE_KEY_PRESS_HOLD_SINGEL
    bool "press and hold button to start a single conversation."   

    config ENABLE_CHAT_MODE_KEY_TRIG_VAD_FREE
    bool "press the button once to start or stop the free conversation."

    config ENABLE_CHAT_MODE_ASR_WAKEUP_SINGEL
    bool "say the wake-up word to initiate a single conversation, similar to a smart speaker."  

    config ENABLE_CHAT_MODE_ASR_WAKEUP_FREE
    bool "saying the wake-up word, you can have a free conversation."  
endchoice

if(ENABLE_CHAT_MODE_ASR_WAKEUP_SINGEL || ENABLE_CHAT_MODE_ASR_WAKEUP_FREE)
    choice    
        prompt "choose wakeup keyword"
        default ENABLE_WAKEUP_KEYWORD_NIHAO_TUYA

        config ENABLE_WAKEUP_KEYWORD_NIHAO_TUYA
        bool "the wake-up word is configured as NI HAO TUYA."   
    
        config ENABLE_WAKEUP_KEYWORD_NIHAO_XIAOZHI
        bool "the wake-up word is configured as NI HAO XIAO ZHI."   

        config ENABLE_WAKEUP_KEYWORD_XIAOZHI_TONGXUE
        bool "the wake-up word is configured as XIAO ZHI TONG XUE."  
    
        config ENABLE_WAKEUP_KEYWORD_XIAOZHI_GUANJIA
        bool "the wake-up word is configured as XIAO ZHI GUAN JIA."  
    endchoice
endif

config ENABLE_CHAT_DISPLAY
    bool "enable the display module"
    default n

    if (ENABLE_CHAT_DISPLAY)
        rsource "./src/display/Kconfig"
    endif

config ENABLE_BMM150_SENSOR
    bool "enable BMM150 magnetometer sensor"
    default y
    help
        Enable BMM150 3-axis magnetometer for compass heading

config ENABLE_GPS_LC76G
    bool "enable LC76G GPS module"
    default y
    help
        Enable LC76G GPS module for location tracking

config ENABLE_ENCODER_INPUT
    bool "enable rotary encoder input"
    default y
    select ENABLE_ENCODER
    help
        Enable rotary encoder for user input (rotation and button press detection)
        
config ENABLE_ENCODER_DRIVER
    bool
    default y if ENABLE_ENCODER_INPUT

if ENABLE_ENCODER_INPUT
    config DECODER_INPUT_A
        int "encoder A signal pin (clockwise detection)"
        range 0 63
        default 16
        help
            GPIO pin for encoder A signal (quadrature input).
            This pin detects clockwise rotation when combined with B signal.

    config DECODER_INPUT_B
        int "encoder B signal pin (counter-clockwise detection)"
        range 0 63
        default 17
        help
            GPIO pin for encoder B signal (quadrature input).
            This pin detects counter-clockwise rotation when combined with A signal.

    config DECODER_INPUT_P
        int "encoder button press detection pin"
        range 0 63
        default 47
        help
            GPIO pin for encoder button/press detection.
            Active low - reads LOW when button is pressed.
endif

config ENABLE_CATTLE_TRACKER_UI
    bool "enable Cattle AI Tracker UI (alternative UI)"
    default y
    depends on ENABLE_CHAT_DISPLAY
    help
        Enable the Cattle AI Tracker UI as an alternative to the default chat UI.
        This provides a compass/GPS-based tracking interface.

config ENABLE_CELLULAR_SUPPORT
    bool "enable cellular support"
    default y
    select ENABLE_CELLULAR if ENABLE_CELLULAR_SUPPORT
    help
        Enable app hardware capability configuration including cellular network functionality.
        This enables 4G/LTE connectivity. Disable this if you only need WiFi connectivity.

config ENABLE_BATTERY
    bool "enable battery"
    default y
    help
        Enable battery voltage monitoring and status reporting functionality.
        This includes battery level detection, charging status, and low battery warnings.

endmenu
```
