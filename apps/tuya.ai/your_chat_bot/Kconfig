## apps/tuya.ai/your_chat_bot/Kconfig
```kconfig
menu "configure app (your_chat_bot) "

config ENABLE_TUYA_AI_V2_0
    bool "enable tuya ai v2.0"
    default y
    help
        enable tuya ai v2.0, default is 1
        if you want to use tuya ai v1.0, please set it to 0

config SPEAKER_EN_PIN
    int "the pin for enabling the voice module"
    range 0 64
    default 28

config CHAT_BUTTON_PIN
    int "the pin of the dialogue button"
    range 0 64
    default 12

config CHAT_INDICATE_LED_PIN
    int "the pin of the led, indicate whether it is in the process of a dialogue."
    range 0 64
    default 1

config ENABLE_CHAT_DISPLAY
    bool "enable the display module"
    default n
    
    if (ENABLE_CHAT_DISPLAY)
        rsource "./src/display/Kconfig"
    endif
endmenu
```

## boards/BK7231X/WB2S/Kconfig
```kconfig
config CHIP_CHOICE
    string
    default "bk7231n"

menu "configure module"
    rsource "../ComKconfig"
endmenu
```

## boards/ESP32/ESP32-C3/Kconfig
```kconfig
config CHIP_CHOICE
    string
    default "esp32c3"

menu "configure module"
    rsource "../ComKconfig"
endmenu
```

## boards/ESP32/ESP32-S3/Kconfig
```kconfig
config CHIP_CHOICE
    string
    default "esp32s3"

menu "configure module"
    rsource "../ComKconfig"
endmenu
```

## boards/ESP32/ESP32/Kconfig
```kconfig
config CHIP_CHOICE
    string
    default "esp32"

menu "configure module"
    rsource "../ComKconfig"
endmenu
```

## boards/ESP32/Waveshare-ESP32-S3-Touch-AMOLED-1.8/Kconfig
```kconfig
config CHIP_CHOICE
    string
    default "esp32s3"

config BOARD_CHOICE
    string
    default "Waveshare-ESP32-S3-Touch-AMOLED-1.8"

config AUDIO_DRIVER_NAME
    string "the name of the audio driver"
    default "audio_driver"
```
